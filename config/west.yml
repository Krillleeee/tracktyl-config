## config/west.yml
```yaml
manifest:
  remotes:
    # ...
    - name: badjeff
      url-base: https://github.com/badjeff
  projects:
    # ...
    # START #####
    - name: zmk-split-peripheral-input-relay
      remote: badjeff
      revision: main
    # END #######
    # ...
```
